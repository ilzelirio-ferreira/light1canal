## light/main/Kconfig.projbuild
```kconfig
menu "Example Configuration"

    config RELAY_ACTIVE_LOW
        bool "Relay outputs are active low (ESP32-S2)"
        depends on IDF_TARGET_ESP32S2
        default n
        help
            Enabled: LOW turns the relay on. Disabled: HIGH turns it on.
            Inputs detect 60 Hz through PC817 optocouplers with internal pull-up.

    config ENABLE_MEMORY_PROFILING
        bool "Enable Memory Profiling"
        default n
        help
            Enable this option to include memory profiling features in the example.
            This will allow you to monitor memory usage during runtime.

endmenu
```
